AUTOSAR XML (schema 4-2-2)
package /RB/UBK/Project/EcucModuleConfigurationValuess
  module config Dem
    DemConfigSet
      61 x DemDTC, all with DemDTCSeverity=DEM_SEVERITY_CHECK_IMMEDIATELY:
        DTC_ADC_SELF_TEST_FAILURE: DemDtcValue=5445526, DemDTCAttributesRef=DemDTCAttributes_Priority1
        DTC_ADC_SELF_TEST_FAILURE: DemDtcValue=5445526, DemDTCAttributesRef=DemDTCAttributes_Priority1
        DTC_ADC_SELF_TEST_FAILURE: DemDtcValue=5445526, DemDTCAttributesRef=DemDTCAttributes_Priority1
        DTC_ADC_SELF_TEST_FAILURE: DemDtcValue=5445526, DemDTCAttributesRef=DemDTCAttributes_Priority1
        DTC_ADC_SELF_TEST_FAILURE: DemDtcValue=5445526, DemDTCAttributesRef=DemDTCAttributes_Priority1
        DTC_ALIGNMENT_NEVER_DONE: DemDtcValue=5440120, DemDTCAttributesRef=DemDTCAttributes_Priority2
        DTC_ALIGNMENT_NOT_OK: DemDtcValue=5440376, DemDTCAttributesRef=DemDTCAttributes_Priority2
        DTC_VBAT_HIGH: DemDtcValue=5439511, DemDTCAttributesRef=DemDTCAttributes_Priority2
        DTC_VBAT_LOW: DemDtcValue=5439510, DemDTCAttributesRef=DemDTCAttributes_Priority2
        DTC_BOSCH_DRIVETEST_ACTIVE: DemDtcValue=5439753, DemDTCAttributesRef=DemDTCAttributes_Priority1
        DTC_CUDA_INVALID: DemDtcValue=5446656, DemDTCAttributesRef=DemDTCAttributes_Priority2
        DTC_CUDA_NOT_AVAILABLE: DemDtcValue=5446400, DemDTCAttributesRef=DemDTCAttributes_Priority2
        DTC_DACORE_OOS: DemDtcValue=5445897, DemDTCAttributesRef=DemDTCAttributes_Priority2
        DTC_FACTORY_DATA_FAILURE: DemDtcValue=5441362, DemDTCAttributesRef=DemDTCAttributes_Priority1
        DTC_HORIZONTAL_MISALIGNED: DemDtcValue=5440888, DemDTCAttributesRef=DemDTCAttributes_Priority2
        DTC_HW_UC_PFLASH: DemDtcValue=5441601, DemDTCAttributesRef=DemDTCAttributes_Priority1
        DTC_INTERNAL_HW_FAILURE: DemDtcValue=5442198, DemDTCAttributesRef=DemDTCAttributes_Priority1
        DTC_INTERNAL_POWER_MANAGEMENT_SYS_FAILURE: DemDtcValue=5441863, DemDTCAttributesRef=DemDTCAttributes_Priority1
        DTC_INTERNAL_UC_SYS_FAILURE: DemDtcValue=5440772, DemDTCAttributesRef=DemDTCAttributes_Priority1
        DTC_INVALID_DATA_BCM: DemDtcValue=12853889, DemDTCAttributesRef=DemDTCAttributes_Priority4
        DTC_INVALID_DATA_CLM: DemDtcValue=12854401, DemDTCAttributesRef=DemDTCAttributes_Priority4
        DTC_INVALID_DATA_EMS: DemDtcValue=12845441, DemDTCAttributesRef=DemDTCAttributes_Priority4
        DTC_INVALID_DATA_EPB: DemDtcValue=12851073, DemDTCAttributesRef=DemDTCAttributes_Priority4
        DTC_INVALID_DATA_EPS: DemDtcValue=12853377, DemDTCAttributesRef=DemDTCAttributes_Priority4
        DTC_INVALID_DATA_ESP: DemDtcValue=12851329, DemDTCAttributesRef=DemDTCAttributes_Priority4
        DTC_INVALID_DATA_FCM: DemDtcValue=13895041, DemDTCAttributesRef=DemDTCAttributes_Priority4
        DTC_INVALID_DATA_ICM: DemDtcValue=12854145, DemDTCAttributesRef=DemDTCAttributes_Priority4
        DTC_INVALID_DATA_IHU: DemDtcValue=12928641, DemDTCAttributesRef=DemDTCAttributes_Priority4
        DTC_INVALID_DATA_MFS: DemDtcValue=12950401, DemDTCAttributesRef=DemDTCAttributes_Priority4
        DTC_INVALID_DATA_TCU: DemDtcValue=12845697, DemDTCAttributesRef=DemDTCAttributes_Priority4
        DTC_INVALID_DATA_YAS: DemDtcValue=12866177, DemDTCAttributesRef=DemDTCAttributes_Priority4
        DTC_MMIC_TEMPERATURE_OVER_MAXIMUM: DemDtcValue=5445016, DemDTCAttributesRef=DemDTCAttributes_Priority1
        DTC_MMIC_TEMPERATURE_OVER_OPERATION: DemDtcValue=5445272, DemDTCAttributesRef=DemDTCAttributes_Priority1
        DTC_MMIC_VOLTAGE_HIGH: DemDtcValue=5442583, DemDTCAttributesRef=DemDTCAttributes_Priority1
        DTC_MMIC_VOLTAGE_LOW: DemDtcValue=5443094, DemDTCAttributesRef=DemDTCAttributes_Priority1
        DTC_MRR_BLIND: DemDtcValue=5446262, DemDTCAttributesRef=DemDTCAttributes_Priority2
        DTC_POWER_MANAGEMENT_CHIP_VOLTAGE_HIGH: DemDtcValue=5442327, DemDTCAttributesRef=DemDTCAttributes_Priority1
        DTC_POWER_MANAGEMENT_CHIP_VOLTAGE_LOW: DemDtcValue=5442838, DemDTCAttributesRef=DemDTCAttributes_Priority1
        DTC_PRIVATE_CAN_BUSOFF: DemDtcValue=12597384, DemDTCAttributesRef=DemDTCAttributes_Priority2
        DTC_PRODUCTION_MODE_ACTIVE: DemDtcValue=5440595, DemDTCAttributesRef=DemDTCAttributes_Priority2
        DTC_PUBLIC_CAN_BUSOFF: DemDtcValue=12612488, DemDTCAttributesRef=DemDTCAttributes_Priority2
        DTC_RADAR_MODULATION: DemDtcValue=5443587, DemDTCAttributesRef=DemDTCAttributes_Priority1
        DTC_RADAR_MODULATION_CONFIGURE: DemDtcValue=5443333, DemDTCAttributesRef=DemDTCAttributes_Priority1
        DTC_SW_FAILURE: DemDtcValue=5443912, DemDTCAttributesRef=DemDTCAttributes_Priority1
        DTC_SW_RIF_FAILURE: DemDtcValue=5444239, DemDTCAttributesRef=DemDTCAttributes_Priority1
        DTC_SW_TEMP_FAILURE: DemDtcValue=5444424, DemDTCAttributesRef=DemDTCAttributes_Priority1
        DTC_TIMEOUT_BCM: DemDtcValue=12664967, DemDTCAttributesRef=DemDTCAttributes_Priority3
        DTC_TIMEOUT_CLM: DemDtcValue=12674183, DemDTCAttributesRef=DemDTCAttributes_Priority3
        DTC_TIMEOUT_EMS: DemDtcValue=12648583, DemDTCAttributesRef=DemDTCAttributes_Priority3
        DTC_TIMEOUT_EPB: DemDtcValue=12658823, DemDTCAttributesRef=DemDTCAttributes_Priority3
        DTC_TIMEOUT_EPS: DemDtcValue=12661127, DemDTCAttributesRef=DemDTCAttributes_Priority3
        DTC_TIMEOUT_ESP: DemDtcValue=12659079, DemDTCAttributesRef=DemDTCAttributes_Priority3
        DTC_TIMEOUT_FCM: DemDtcValue=13722247, DemDTCAttributesRef=DemDTCAttributes_Priority3
        DTC_TIMEOUT_ICM: DemDtcValue=12670343, DemDTCAttributesRef=DemDTCAttributes_Priority3
        DTC_TIMEOUT_IHU: DemDtcValue=12731783, DemDTCAttributesRef=DemDTCAttributes_Priority3
        DTC_TIMEOUT_MFS: DemDtcValue=12683655, DemDTCAttributesRef=DemDTCAttributes_Priority3
        DTC_TIMEOUT_TCU: DemDtcValue=12648839, DemDTCAttributesRef=DemDTCAttributes_Priority3
        DTC_TIMEOUT_YAS: DemDtcValue=12669319, DemDTCAttributesRef=DemDTCAttributes_Priority3
        DTC_UC_TEMPERATURE_OUTOFRANGE: DemDtcValue=5444683, DemDTCAttributesRef=DemDTCAttributes_Priority1
        DTC_VERTICAL_MISALIGNED: DemDtcValue=5441144, DemDTCAttributesRef=DemDTCAttributes_Priority2
        DTC_VMC_FAILURE: DemDtcValue=5445715, DemDTCAttributesRef=DemDTCAttributes_Priority2
      128 x DemEventParameter, all with DemEventAvailable=true, DemEventFailureCycleCounterThreshold=1, DemEventKind=DEM_EVENT_KIND_BSW, DemFFPrestorageSupported=false, DemReportBehavior=REPORT_AFTER_INIT, DemOperationCycleRef=IgnitionCycle:
        FAULT_ALV_ABS_ESP_1: DemCallbackEventStatusChangedRBRef=DemCallbackEventStatusChanged_Prj, DemDTCRef=DTC_INVALID_DATA_ESP, DemEnableConditionGroupRef=ECG_PublicCAN
          DemDebounceAlgorithmClass
            DemDebounceCounterBased: DemDebounceCounterBasedClassRef=DemDebounceCounterBasedClass_5_1_5
          DemRbEventClass: DemRbEventRecoverableInSameOperationCycle=true, DemRbEventStatusBitStorageTestFailed=false, DemRbEventCategoryRef=DemRbEventCategory_External
        FAULT_ALV_ABS_ESP_3: DemCallbackEventStatusChangedRBRef=DemCallbackEventStatusChanged_Prj, DemDTCRef=DTC_INVALID_DATA_ESP, DemEnableConditionGroupRef=ECG_PublicCAN
          DemDebounceAlgorithmClass
            DemDebounceCounterBased: DemDebounceCounterBasedClassRef=DemDebounceCounterBasedClass_5_1_5
          DemRbEventClass: DemRbEventRecoverableInSameOperationCycle=true, DemRbEventStatusBitStorageTestFailed=false, DemRbEventCategoryRef=DemRbEventCategory_External
        FAULT_ALV_ABS_ESP_4: DemCallbackEventStatusChangedRBRef=DemCallbackEventStatusChanged_Prj, DemDTCRef=DTC_INVALID_DATA_ESP, DemEnableConditionGroupRef=ECG_PublicCAN
          DemDebounceAlgorithmClass
            DemDebounceCounterBased: DemDebounceCounterBasedClassRef=DemDebounceCounterBasedClass_5_1_5
          DemRbEventClass: DemRbEventRecoverableInSameOperationCycle=true, DemRbEventStatusBitStorageTestFailed=false, DemRbEventCategoryRef=DemRbEventCategory_External
        FAULT_ALV_ABS_ESP_7: DemCallbackEventStatusChangedRBRef=DemCallbackEventStatusChanged_Prj, DemDTCRef=DTC_INVALID_DATA_ESP, DemEnableConditionGroupRef=ECG_PublicCAN
          DemDebounceAlgorithmClass
            DemDebounceCounterBased: DemDebounceCounterBasedClassRef=DemDebounceCounterBasedClass_5_1_5
          DemRbEventClass: DemRbEventRecoverableInSameOperationCycle=true, DemRbEventStatusBitStorageTestFailed=false, DemRbEventCategoryRef=DemRbEventCategory_External
        FAULT_ALV_ABS_ESP_8: DemCallbackEventStatusChangedRBRef=DemCallbackEventStatusChanged_Prj, DemDTCRef=DTC_INVALID_DATA_ESP, DemEnableConditionGroupRef=ECG_PublicCAN
          DemDebounceAlgorithmClass
            DemDebounceCounterBased: DemDebounceCounterBasedClassRef=DemDebounceCounterBasedClass_5_1_5
          DemRbEventClass: DemRbEventRecoverableInSameOperationCycle=true, DemRbEventStatusBitStorageTestFailed=false, DemRbEventCategoryRef=DemRbEventCategory_External
        FAULT_ALV_BCM_1: DemCallbackEventStatusChangedRBRef=DemCallbackEventStatusChanged_Prj, DemDTCRef=DTC_INVALID_DATA_BCM, DemEnableConditionGroupRef=ECG_PublicCAN
          DemDebounceAlgorithmClass
            DemDebounceCounterBased: DemDebounceCounterBasedClassRef=DemDebounceCounterBasedClass_5_1_5
          DemRbEventClass: DemRbEventRecoverableInSameOperationCycle=true, DemRbEventStatusBitStorageTestFailed=false, DemRbEventCategoryRef=DemRbEventCategory_External
        FAULT_ALV_CLM_2: DemCallbackEventStatusChangedRBRef=DemCallbackEventStatusChanged_Prj, DemDTCRef=DTC_INVALID_DATA_CLM, DemEnableConditionGroupRef=ECG_PublicCAN
          DemDebounceAlgorithmClass
            DemDebounceCounterBased: DemDebounceCounterBasedClassRef=DemDebounceCounterBasedClass_5_1_5
          DemRbEventClass: DemRbEventRecoverableInSameOperationCycle=true, DemRbEventStatusBitStorageTestFailed=false, DemRbEventCategoryRef=DemRbEventCategory_External
        FAULT_ALV_EMS_1: DemCallbackEventStatusChangedRBRef=DemCallbackEventStatusChanged_Prj, DemDTCRef=DTC_INVALID_DATA_EMS, DemEnableConditionGroupRef=ECG_PublicCAN
          DemDebounceAlgorithmClass
            DemDebounceCounterBased: DemDebounceCounterBasedClassRef=DemDebounceCounterBasedClass_5_1_5
          DemRbEventClass: DemRbEventRecoverableInSameOperationCycle=true, DemRbEventStatusBitStorageTestFailed=false, DemRbEventCategoryRef=DemRbEventCategory_External
        FAULT_ALV_EMS_2_G: DemCallbackEventStatusChangedRBRef=DemCallbackEventStatusChanged_Prj, DemDTCRef=DTC_INVALID_DATA_EMS, DemEnableConditionGroupRef=ECG_PublicCAN
          DemDebounceAlgorithmClass
            DemDebounceCounterBased: DemDebounceCounterBasedClassRef=DemDebounceCounterBasedClass_5_1_5
          DemRbEventClass: DemRbEventRecoverableInSameOperationCycle=true, DemRbEventStatusBitStorageTestFailed=false, DemRbEventCategoryRef=DemRbEventCategory_External
        FAULT_ALV_EMS_6: DemCallbackEventStatusChangedRBRef=DemCallbackEventStatusChanged_Prj, DemDTCRef=DTC_INVALID_DATA_EMS, DemEnableConditionGroupRef=ECG_PublicCAN
          DemDebounceAlgorithmClass
            DemDebounceCounterBased: DemDebounceCounterBasedClassRef=DemDebounceCounterBasedClass_5_1_5
          DemRbEventClass: DemRbEventRecoverableInSameOperationCycle=true, DemRbEventStatusBitStorageTestFailed=false, DemRbEventCategoryRef=DemRbEventCategory_External
        FAULT_ALV_EPS_3: DemCallbackEventStatusChangedRBRef=DemCallbackEventStatusChanged_Prj, DemDTCRef=DTC_INVALID_DATA_EPS, DemEnableConditionGroupRef=ECG_PublicCAN
          DemDebounceAlgorithmClass
            DemDebounceCounterBased: DemDebounceCounterBasedClassRef=DemDebounceCounterBasedClass_5_1_5
          DemRbEventClass: DemRbEventRecoverableInSameOperationCycle=true, DemRbEventStatusBitStorageTestFailed=false, DemRbEventCategoryRef=DemRbEventCategory_External
        FAULT_ALV_ICM_1: DemCallbackEventStatusChangedRBRef=DemCallbackEventStatusChanged_Prj, DemDTCRef=DTC_INVALID_DATA_ICM, DemEnableConditionGroupRef=ECG_PublicCAN
          DemDebounceAlgorithmClass
            DemDebounceCounterBased: DemDebounceCounterBasedClassRef=DemDebounceCounterBasedClass_5_1_5
          DemRbEventClass: DemRbEventRecoverableInSameOperationCycle=true, DemRbEventStatusBitStorageTestFailed=false, DemRbEventCategoryRef=DemRbEventCategory_External
        FAULT_ALV_ICM_5: DemCallbackEventStatusChangedRBRef=DemCallbackEventStatusChanged_Prj, DemDTCRef=DTC_INVALID_DATA_ICM, DemEnableConditionGroupRef=ECG_PublicCAN
          DemDebounceAlgorithmClass
            DemDebounceCounterBased: DemDebounceCounterBasedClassRef=DemDebounceCounterBasedClass_5_1_5
          DemRbEventClass: DemRbEventRecoverableInSameOperationCycle=true, DemRbEventStatusBitStorageTestFailed=false, DemRbEventCategoryRef=DemRbEventCategory_External
        FAULT_ALV_MFS_2: DemCallbackEventStatusChangedRBRef=DemCallbackEventStatusChanged_Prj, DemDTCRef=DTC_INVALID_DATA_MFS, DemEnableConditionGroupRef=ECG_PublicCAN
          DemDebounceAlgorithmClass
            DemDebounceCounterBased: DemDebounceCounterBasedClassRef=DemDebounceCounterBasedClass_5_1_5
          DemRbEventClass: DemRbEventRecoverableInSameOperationCycle=true, DemRbEventStatusBitStorageTestFailed=false, DemRbEventCategoryRef=DemRbEventCategory_External
        FAULT_ALV_TCU_2: DemCallbackEventStatusChangedRBRef=DemCallbackEventStatusChanged_Prj, DemDTCRef=DTC_INVALID_DATA_TCU, DemEnableConditionGroupRef=ECG_PublicCAN
          DemDebounceAlgorithmClass
            DemDebounceCounterBased: DemDebounceCounterBasedClassRef=DemDebounceCounterBasedClass_5_1_5
          DemRbEventClass: DemRbEventRecoverableInSameOperationCycle=true, DemRbEventStatusBitStorageTestFailed=false, DemRbEventCategoryRef=DemRbEventCategory_External
        FAULT_ALV_TCU_4: DemCallbackEventStatusChangedRBRef=DemCallbackEventStatusChanged_Prj, DemDTCRef=DTC_INVALID_DATA_TCU, DemEnableConditionGroupRef=ECG_PublicCAN
          DemDebounceAlgorithmClass
            DemDebounceCounterBased: DemDebounceCounterBasedClassRef=DemDebounceCounterBasedClass_5_1_5
          DemRbEventClass: DemRbEventRecoverableInSameOperationCycle=true, DemRbEventStatusBitStorageTestFailed=false, DemRbEventCategoryRef=DemRbEventCategory_External
        FAULT_ALV_YAS_1: DemCallbackEventStatusChangedRBRef=DemCallbackEventStatusChanged_Prj, DemDTCRef=DTC_INVALID_DATA_YAS, DemEnableConditionGroupRef=ECG_PublicCAN
          DemDebounceAlgorithmClass
            DemDebounceCounterBased: DemDebounceCounterBasedClassRef=DemDebounceCounterBasedClass_5_1_5
          DemRbEventClass: DemRbEventRecoverableInSameOperationCycle=true, DemRbEventStatusBitStorageTestFailed=false, DemRbEventCategoryRef=DemRbEventCategory_External
        FAULT_ALV_YAS_2: DemCallbackEventStatusChangedRBRef=DemCallbackEventStatusChanged_Prj, DemDTCRef=DTC_INVALID_DATA_YAS, DemEnableConditionGroupRef=ECG_PublicCAN
          DemDebounceAlgorithmClass
            DemDebounceCounterBased: DemDebounceCounterBasedClassRef=DemDebounceCounterBasedClass_5_1_5
          DemRbEventClass: DemRbEventRecoverableInSameOperationCycle=true, DemRbEventStatusBitStorageTestFailed=false, DemRbEventCategoryRef=DemRbEventCategory_External
        FAULT_ABS_ESP_1_ABSFailSts_INVALID: DemComponentPriority=4, DemCallbackEventStatusChangedRBRef=DemCallbackEventStatusChanged_Prj, DemDTCRef=DTC_INVALID_DATA_ESP, DemEnableConditionGroupRef=ECG_PublicCAN
          DemDebounceAlgorithmClass
            DemDebounceCounterBased: DemDebounceCounterBasedClassRef=DemDebounceCounterBasedClass_10_1_10
          DemRbEventClass: DemRbEventRecoverableInSameOperationCycle=true, DemRbEventStatusBitStorageTestFailed=false, DemRbEventCategoryRef=DemRbEventCategory_External
        FAULT_ABS_ESP_1_EBDFailSts_INVALID: DemComponentPriority=4, DemCallbackEventStatusChangedRBRef=DemCallbackEventStatusChanged_Prj, DemDTCRef=DTC_INVALID_DATA_ESP, DemEnableConditionGroupRef=ECG_PublicCAN
          DemDebounceAlgorithmClass
            DemDebounceCounterBased: DemDebounceCounterBasedClassRef=DemDebounceCounterBasedClass_10_1_10
          DemRbEventClass: DemRbEventRecoverableInSameOperationCycle=true, DemRbEventStatusBitStorageTestFailed=false, DemRbEventCategoryRef=DemRbEventCategory_External
        FAULT_ABS_ESP_1_HDCFailSts_INVALID: DemComponentPriority=4, DemCallbackEventStatusChangedRBRef=DemCallbackEventStatusChanged_Prj, DemDTCRef=DTC_INVALID_DATA_ESP, DemEnableConditionGroupRef=ECG_PublicCAN
          DemDebounceAlgorithmClass
            DemDebounceCounterBased: DemDebounceCounterBasedClassRef=DemDebounceCounterBasedClass_10_1_10
          DemRbEventClass: DemRbEventRecoverableInSameOperationCycle=true, DemRbEventStatusBitStorageTestFailed=false, DemRbEventCategoryRef=DemRbEventCategory_External
        FAULT_ABS_ESP_1_TCSFailSts_INVALID: DemComponentPriority=4, DemCallbackEventStatusChangedRBRef=DemCallbackEventStatusChanged_Prj, DemDTCRef=DTC_INVALID_DATA_ESP, DemEnableConditionGroupRef=ECG_PublicCAN
          DemDebounceAlgorithmClass
            DemDebounceCounterBased: DemDebounceCounterBasedClassRef=DemDebounceCounterBasedClass_10_1_10
          DemRbEventClass: DemRbEventRecoverableInSameOperationCycle=true, DemRbEventStatusBitStorageTestFailed=false, DemRbEventCategoryRef=DemRbEventCategory_External
        FAULT_ABS_ESP_1_VDCFailSts_INVALID: DemComponentPriority=4, DemCallbackEventStatusChangedRBRef=DemCallbackEventStatusChanged_Prj, DemDTCRef=DTC_INVALID_DATA_ESP, DemEnableConditionGroupRef=ECG_PublicCAN
          DemDebounceAlgorithmClass
            DemDebounceCounterBased: DemDebounceCounterBasedClassRef=DemDebounceCounterBasedClass_10_1_10
          DemRbEventClass: DemRbEventRecoverableInSameOperationCycle=true, DemRbEventStatusBitStorageTestFailed=false, DemRbEventCategoryRef=DemRbEventCategory_External
        FAULT_ABS_ESP_3_AVHFailSts_INVALID: DemComponentPriority=4, DemCallbackEventStatusChangedRBRef=DemCallbackEventStatusChanged_Prj, DemDTCRef=DTC_INVALID_DATA_ESP, DemEnableConditionGroupRef=ECG_PublicCAN
          DemDebounceAlgorithmClass
            DemDebounceCounterBased: DemDebounceCounterBasedClassRef=DemDebounceCounterBasedClass_7_1_7
          DemRbEventClass: DemRbEventRecoverableInSameOperationCycle=true, DemRbEventStatusBitStorageTestFailed=false, DemRbEventCategoryRef=DemRbEventCategory_External
        FAULT_AcceleratorPosRaw_INVALID: DemComponentPriority=4, DemCallbackEventStatusChangedRBRef=DemCallbackEventStatusChanged_Prj, DemDTCRef=DTC_INVALID_DATA_EMS, DemEnableConditionGroupRef=ECG_PublicCAN
          DemDebounceAlgorithmClass
            DemDebounceCounterBased: DemDebounceCounterBasedClassRef=DemDebounceCounterBasedClass_10_1_10
          DemRbEventClass: DemRbEventRecoverableInSameOperationCycle=true, DemRbEventStatusBitStorageTestFailed=false, DemRbEventCategoryRef=DemRbEventCategory_External
        FAULT_AEBdecAvailable_INVALID: DemComponentPriority=4, DemCallbackEventStatusChangedRBRef=DemCallbackEventStatusChanged_Prj, DemDTCRef=DTC_INVALID_DATA_ESP, DemEnableConditionGroupRef=ECG_PublicCAN
          DemDebounceAlgorithmClass
            DemDebounceCounterBased: DemDebounceCounterBasedClassRef=DemDebounceCounterBasedClass_10_1_10
          DemRbEventClass: DemRbEventRecoverableInSameOperationCycle=true, DemRbEventStatusBitStorageTestFailed=false, DemRbEventCategoryRef=DemRbEventCategory_External
        FAULT_VBAT_HIGH: DemComponentPriority=2, DemCallbackEventStatusChangedRBRef=DemCallbackEventStatusChanged_Prj, DemDTCRef=DTC_VBAT_HIGH, DemEnableConditionGroupRef=ECG_Voltage
          DemDebounceAlgorithmClass
            DemDebounceTimeBase: DemDebounceTimeBaseRef=DemDebounceTimeBaseClass_VoltageMonitoring
          DemRbEventClass: DemRbEventRecoverableInSameOperationCycle=true, DemRbEventStatusBitStorageTestFailed=false, DemRbEventCategoryRef=DemRbEventCategory_External
        FAULT_VBAT_LOW: DemComponentPriority=2, DemCallbackEventStatusChangedRBRef=DemCallbackEventStatusChanged_Prj, DemDTCRef=DTC_VBAT_LOW, DemEnableConditionGroupRef=ECG_Voltage
          DemDebounceAlgorithmClass
            DemDebounceTimeBase: DemDebounceTimeBaseRef=DemDebounceTimeBaseClass_VoltageMonitoring
          DemRbEventClass: DemRbEventRecoverableInSameOperationCycle=true, DemRbEventStatusBitStorageTestFailed=false, DemRbEventCategoryRef=DemRbEventCategory_External
        FAULT_AWBavailable_INVALID: DemCallbackEventStatusChangedRBRef=DemCallbackEventStatusChanged_Prj, DemDTCRef=DTC_INVALID_DATA_ESP, DemEnableConditionGroupRef=ECG_PublicCAN
          DemDebounceAlgorithmClass
            DemDebounceCounterBased: DemDebounceCounterBasedClassRef=DemDebounceCounterBasedClass_10_1_10
          DemRbEventClass: DemRbEventRecoverableInSameOperationCycle=true, DemRbEventStatusBitStorageTestFailed=false, DemRbEventCategoryRef=DemRbEventCategory_External
        FAULT_BrakePedalStsValidDataForTCU_INVALID: DemCallbackEventStatusChangedRBRef=DemCallbackEventStatusChanged_Prj, DemDTCRef=DTC_INVALID_DATA_EMS, DemEnableConditionGroupRef=ECG_PublicCAN
          DemDebounceAlgorithmClass
            DemDebounceCounterBased: DemDebounceCounterBasedClassRef=DemDebounceCounterBasedClass_10_1_10
          DemRbEventClass: DemRbEventRecoverableInSameOperationCycle=true, DemRbEventStatusBitStorageTestFailed=false, DemRbEventCategoryRef=DemRbEventCategory_External
        FAULT_CDDAvailable_INVALID: DemCallbackEventStatusChangedRBRef=DemCallbackEventStatusChanged_Prj, DemDTCRef=DTC_INVALID_DATA_ESP, DemEnableConditionGroupRef=ECG_PublicCAN
          DemDebounceAlgorithmClass
            DemDebounceCounterBased: DemDebounceCounterBasedClassRef=DemDebounceCounterBasedClass_10_1_10
          DemRbEventClass: DemRbEventRecoverableInSameOperationCycle=true, DemRbEventStatusBitStorageTestFailed=false, DemRbEventCategoryRef=DemRbEventCategory_External
        FAULT_CHK_ABS_ESP_1: DemCallbackEventStatusChangedRBRef=DemCallbackEventStatusChanged_Prj, DemDTCRef=DTC_INVALID_DATA_ESP, DemEnableConditionGroupRef=ECG_PublicCAN
          DemDebounceAlgorithmClass
            DemDebounceCounterBased: DemDebounceCounterBasedClassRef=DemDebounceCounterBasedClass_5_1_5
          DemRbEventClass: DemRbEventRecoverableInSameOperationCycle=true, DemRbEventStatusBitStorageTestFailed=false, DemRbEventCategoryRef=DemRbEventCategory_External
        FAULT_CHK_ABS_ESP_3: DemCallbackEventStatusChangedRBRef=DemCallbackEventStatusChanged_Prj, DemDTCRef=DTC_INVALID_DATA_ESP, DemEnableConditionGroupRef=ECG_PublicCAN
          DemDebounceAlgorithmClass
            DemDebounceCounterBased: DemDebounceCounterBasedClassRef=DemDebounceCounterBasedClass_5_1_5
          DemRbEventClass: DemRbEventRecoverableInSameOperationCycle=true, DemRbEventStatusBitStorageTestFailed=false, DemRbEventCategoryRef=DemRbEventCategory_External
        FAULT_CHK_ABS_ESP_4: DemCallbackEventStatusChangedRBRef=DemCallbackEventStatusChanged_Prj, DemDTCRef=DTC_INVALID_DATA_ESP, DemEnableConditionGroupRef=ECG_PublicCAN
          DemDebounceAlgorithmClass
            DemDebounceCounterBased: DemDebounceCounterBasedClassRef=DemDebounceCounterBasedClass_5_1_5
          DemRbEventClass: DemRbEventRecoverableInSameOperationCycle=true, DemRbEventStatusBitStorageTestFailed=false, DemRbEventCategoryRef=DemRbEventCategory_External
        FAULT_CHK_ABS_ESP_7: DemCallbackEventStatusChangedRBRef=DemCallbackEventStatusChanged_Prj, DemDTCRef=DTC_INVALID_DATA_ESP, DemEnableConditionGroupRef=ECG_PublicCAN
          DemDebounceAlgorithmClass
            DemDebounceCounterBased: DemDebounceCounterBasedClassRef=DemDebounceCounterBasedClass_5_1_5
          DemRbEventClass: DemRbEventRecoverableInSameOperationCycle=true, DemRbEventStatusBitStorageTestFailed=false, DemRbEventCategoryRef=DemRbEventCategory_External
        FAULT_CHK_ABS_ESP_8: DemCallbackEventStatusChangedRBRef=DemCallbackEventStatusChanged_Prj, DemDTCRef=DTC_INVALID_DATA_ESP, DemEnableConditionGroupRef=ECG_PublicCAN
          DemDebounceAlgorithmClass
            DemDebounceCounterBased: DemDebounceCounterBasedClassRef=DemDebounceCounterBasedClass_5_1_5
          DemRbEventClass: DemRbEventRecoverableInSameOperationCycle=true, DemRbEventStatusBitStorageTestFailed=false, DemRbEventCategoryRef=DemRbEventCategory_External
        FAULT_CHK_BCM_1: DemCallbackEventStatusChangedRBRef=DemCallbackEventStatusChanged_Prj, DemDTCRef=DTC_INVALID_DATA_BCM, DemEnableConditionGroupRef=ECG_PublicCAN
          DemDebounceAlgorithmClass
            DemDebounceCounterBased: DemDebounceCounterBasedClassRef=DemDebounceCounterBasedClass_5_1_5
          DemRbEventClass: DemRbEventRecoverableInSameOperationCycle=true, DemRbEventStatusBitStorageTestFailed=false, DemRbEventCategoryRef=DemRbEventCategory_External
        FAULT_CHK_CLM_2: DemCallbackEventStatusChangedRBRef=DemCallbackEventStatusChanged_Prj, DemDTCRef=DTC_INVALID_DATA_CLM, DemEnableConditionGroupRef=ECG_PublicCAN
          DemDebounceAlgorithmClass
            DemDebounceCounterBased: DemDebounceCounterBasedClassRef=DemDebounceCounterBasedClass_5_1_5
          DemRbEventClass: DemRbEventRecoverableInSameOperationCycle=true, DemRbEventStatusBitStorageTestFailed=false, DemRbEventCategoryRef=DemRbEventCategory_External
        FAULT_CHK_EMS_1: DemCallbackEventStatusChangedRBRef=DemCallbackEventStatusChanged_Prj, DemDTCRef=DTC_INVALID_DATA_EMS, DemEnableConditionGroupRef=ECG_PublicCAN
          DemDebounceAlgorithmClass
            DemDebounceCounterBased: DemDebounceCounterBasedClassRef=DemDebounceCounterBasedClass_5_1_5
          DemRbEventClass: DemRbEventRecoverableInSameOperationCycle=true, DemRbEventStatusBitStorageTestFailed=false, DemRbEventCategoryRef=DemRbEventCategory_External
        FAULT_CHK_EMS_2_G: DemCallbackEventStatusChangedRBRef=DemCallbackEventStatusChanged_Prj, DemDTCRef=DTC_INVALID_DATA_EMS, DemEnableConditionGroupRef=ECG_PublicCAN
          DemDebounceAlgorithmClass
            DemDebounceCounterBased: DemDebounceCounterBasedClassRef=DemDebounceCounterBasedClass_5_1_5
          DemRbEventClass: DemRbEventRecoverableInSameOperationCycle=true, DemRbEventStatusBitStorageTestFailed=false, DemRbEventCategoryRef=DemRbEventCategory_External
        FAULT_CHK_EMS_6: DemCallbackEventStatusChangedRBRef=DemCallbackEventStatusChanged_Prj, DemDTCRef=DTC_INVALID_DATA_EMS, DemEnableConditionGroupRef=ECG_PublicCAN
          DemDebounceAlgorithmClass
            DemDebounceCounterBased: DemDebounceCounterBasedClassRef=DemDebounceCounterBasedClass_5_1_5
          DemRbEventClass: DemRbEventRecoverableInSameOperationCycle=true, DemRbEventStatusBitStorageTestFailed=false, DemRbEventCategoryRef=DemRbEventCategory_External
        FAULT_CHK_EPS_3: DemCallbackEventStatusChangedRBRef=DemCallbackEventStatusChanged_Prj, DemDTCRef=DTC_INVALID_DATA_EPS, DemEnableConditionGroupRef=ECG_PublicCAN
          DemDebounceAlgorithmClass
            DemDebounceCounterBased: DemDebounceCounterBasedClassRef=DemDebounceCounterBasedClass_5_1_5
          DemRbEventClass: DemRbEventRecoverableInSameOperationCycle=true, DemRbEventStatusBitStorageTestFailed=false, DemRbEventCategoryRef=DemRbEventCategory_External
        FAULT_CHK_ICM_5: DemCallbackEventStatusChangedRBRef=DemCallbackEventStatusChanged_Prj, DemDTCRef=DTC_INVALID_DATA_ICM, DemEnableConditionGroupRef=ECG_PublicCAN
          DemDebounceAlgorithmClass
            DemDebounceCounterBased: DemDebounceCounterBasedClassRef=DemDebounceCounterBasedClass_5_1_5
          DemRbEventClass: DemRbEventRecoverableInSameOperationCycle=true, DemRbEventStatusBitStorageTestFailed=false, DemRbEventCategoryRef=DemRbEventCategory_External
        FAULT_CHK_MFS_2: DemCallbackEventStatusChangedRBRef=DemCallbackEventStatusChanged_Prj, DemDTCRef=DTC_INVALID_DATA_MFS, DemEnableConditionGroupRef=ECG_PublicCAN
          DemDebounceAlgorithmClass
            DemDebounceCounterBased: DemDebounceCounterBasedClassRef=DemDebounceCounterBasedClass_5_1_5
          DemRbEventClass: DemRbEventRecoverableInSameOperationCycle=true, DemRbEventStatusBitStorageTestFailed=false, DemRbEventCategoryRef=DemRbEventCategory_External
        FAULT_CHK_TCU_2: DemCallbackEventStatusChangedRBRef=DemCallbackEventStatusChanged_Prj, DemDTCRef=DTC_INVALID_DATA_TCU, DemEnableConditionGroupRef=ECG_PublicCAN
          DemDebounceAlgorithmClass
            DemDebounceCounterBased: DemDebounceCounterBasedClassRef=DemDebounceCounterBasedClass_5_1_5
          DemRbEventClass: DemRbEventRecoverableInSameOperationCycle=true, DemRbEventStatusBitStorageTestFailed=false, DemRbEventCategoryRef=DemRbEventCategory_External
        FAULT_CHK_TCU_4: DemCallbackEventStatusChangedRBRef=DemCallbackEventStatusChanged_Prj, DemDTCRef=DTC_INVALID_DATA_TCU, DemEnableConditionGroupRef=ECG_PublicCAN
          DemDebounceAlgorithmClass
            DemDebounceCounterBased: DemDebounceCounterBasedClassRef=DemDebounceCounterBasedClass_5_1_5
          DemRbEventClass: DemRbEventRecoverableInSameOperationCycle=true, DemRbEventStatusBitStorageTestFailed=false, DemRbEventCategoryRef=DemRbEventCategory_External
        FAULT_CHK_YAS_1: DemCallbackEventStatusChangedRBRef=DemCallbackEventStatusChanged_Prj, DemDTCRef=DTC_INVALID_DATA_YAS, DemEnableConditionGroupRef=ECG_PublicCAN
          DemDebounceAlgorithmClass
            DemDebounceCounterBased: DemDebounceCounterBasedClassRef=DemDebounceCounterBasedClass_5_1_5
          DemRbEventClass: DemRbEventRecoverableInSameOperationCycle=true, DemRbEventStatusBitStorageTestFailed=false, DemRbEventCategoryRef=DemRbEventCategory_External
        FAULT_CHK_YAS_2: DemCallbackEventStatusChangedRBRef=DemCallbackEventStatusChanged_Prj, DemDTCRef=DTC_INVALID_DATA_YAS, DemEnableConditionGroupRef=ECG_PublicCAN
          DemDebounceAlgorithmClass
            DemDebounceCounterBased: DemDebounceCounterBasedClassRef=DemDebounceCounterBasedClass_5_1_5
          DemRbEventClass: DemRbEventRecoverableInSameOperationCycle=true, DemRbEventStatusBitStorageTestFailed=false, DemRbEventCategoryRef=DemRbEventCategory_External
        FAULT_CUDA_INVALID: DemRbEventDescription=This is reference Event configuration for Testing UseCase, DemDTCRef=DTC_CUDA_INVALID, DemEnableConditionGroupRef=ECG_DriveTest
          DemDebounceAlgorithmClass
            DemDebounceTimeBase: DemDebounceTimeBaseRef=DemDebounceTimeBaseClass_immidiate
          DemRbEventClass: DemRbEventRecoverableInSameOperationCycle=true, DemRbEventStatusBitStorageTestFailed=false, DemRbEventCategoryRef=DemRbEventCategory_External
        FAULT_CUDA_NOT_AVAILABLE: DemRbEventDescription=This is reference Event configuration for Testing UseCase, DemDTCRef=DTC_CUDA_NOT_AVAILABLE, DemEnableConditionGroupRef=ECG_DriveTest
          DemDebounceAlgorithmClass
            DemDebounceTimeBase: DemDebounceTimeBaseRef=DemDebounceTimeBaseClass_immidiate
          DemRbEventClass: DemRbEventRecoverableInSameOperationCycle=true, DemRbEventStatusBitStorageTestFailed=false, DemRbEventCategoryRef=DemRbEventCategory_External
        FAULT_DCFail_INVALID: DemCallbackEventStatusChangedRBRef=DemCallbackEventStatusChanged_Prj, DemDTCRef=DTC_INVALID_DATA_ESP, DemEnableConditionGroupRef=ECG_PublicCAN
          DemDebounceAlgorithmClass
            DemDebounceCounterBased: DemDebounceCounterBasedClassRef=DemDebounceCounterBasedClass_10_1_10
          DemRbEventClass: DemRbEventRecoverableInSameOperationCycle=true, DemRbEventStatusBitStorageTestFailed=false, DemRbEventCategoryRef=DemRbEventCategory_External
        FAULT_Dev_Video_SyncVisor_TX_TIMEOUT: DemCallbackEventStatusChangedRBRef=DemCallbackEventStatusChanged_Prj, DemDTCRef=DTC_TIMEOUT_FCM, DemEnableConditionGroupRef=ECG_PrivateCAN
          DemDebounceAlgorithmClass
            DemDebounceCounterBased: DemDebounceCounterBasedClassRef=DemDebounceCounterBasedClass_4_1_4
          DemRbEventClass: DemRbEventRecoverableInSameOperationCycle=true, DemRbEventStatusBitStorageTestFailed=false, DemRbEventCategoryRef=DemRbEventCategory_External
        FAULT_DISFail_INVALID: DemCallbackEventStatusChangedRBRef=DemCallbackEventStatusChanged_Prj, DemDTCRef=DTC_INVALID_DATA_ICM, DemEnableConditionGroupRef=ECG_PublicCAN
          DemDebounceAlgorithmClass
            DemDebounceCounterBased: DemDebounceCounterBasedClassRef=DemDebounceCounterBasedClass_10_1_10
          DemRbEventClass: DemRbEventRecoverableInSameOperationCycle=true, DemRbEventStatusBitStorageTestFailed=false, DemRbEventCategoryRef=DemRbEventCategory_External
        FAULT_DriverDoorStsQbit_INVALID: DemCallbackEventStatusChangedRBRef=DemCallbackEventStatusChanged_Prj, DemDTCRef=DTC_INVALID_DATA_BCM, DemEnableConditionGroupRef=ECG_PublicCAN
          DemDebounceAlgorithmClass
            DemDebounceCounterBased: DemDebounceCounterBasedClassRef=DemDebounceCounterBasedClass_10_1_10
          DemRbEventClass: DemRbEventRecoverableInSameOperationCycle=true, DemRbEventStatusBitStorageTestFailed=false, DemRbEventCategoryRef=DemRbEventCategory_External
        FAULT_DriverSeatBeltSwitchQbit_INVALID: DemCallbackEventStatusChangedRBRef=DemCallbackEventStatusChanged_Prj, DemDTCRef=DTC_INVALID_DATA_ICM, DemEnableConditionGroupRef=ECG_PublicCAN
          DemDebounceAlgorithmClass
            DemDebounceCounterBased: DemDebounceCounterBasedClassRef=DemDebounceCounterBasedClass_10_1_10
          DemRbEventClass: DemRbEventRecoverableInSameOperationCycle=true, DemRbEventStatusBitStorageTestFailed=false, DemRbEventCategoryRef=DemRbEventCategory_External
        FAULT_ECFail_INVALID: DemCallbackEventStatusChangedRBRef=DemCallbackEventStatusChanged_Prj, DemDTCRef=DTC_INVALID_DATA_EMS, DemEnableConditionGroupRef=ECG_PublicCAN
          DemDebounceAlgorithmClass
            DemDebounceCounterBased: DemDebounceCounterBasedClassRef=DemDebounceCounterBasedClass_10_1_10
          DemRbEventClass: DemRbEventRecoverableInSameOperationCycle=true, DemRbEventStatusBitStorageTestFailed=false, DemRbEventCategoryRef=DemRbEventCategory_External
        FAULT_ECGPOvrdInvalidData_INVALID: DemCallbackEventStatusChangedRBRef=DemCallbackEventStatusChanged_Prj, DemDTCRef=DTC_INVALID_DATA_EMS, DemEnableConditionGroupRef=ECG_PublicCAN
          DemDebounceAlgorithmClass
            DemDebounceCounterBased: DemDebounceCounterBasedClassRef=DemDebounceCounterBasedClass_10_1_10
          DemRbEventClass: DemRbEventRecoverableInSameOperationCycle=true, DemRbEventStatusBitStorageTestFailed=false, DemRbEventCategoryRef=DemRbEventCategory_External
        FAULT_EngineStsForDCT_INVALID: DemCallbackEventStatusChangedRBRef=DemCallbackEventStatusChanged_Prj, DemDTCRef=DTC_INVALID_DATA_EMS, DemEnableConditionGroupRef=ECG_PublicCAN
          DemDebounceAlgorithmClass
            DemDebounceCounterBased: DemDebounceCounterBasedClassRef=DemDebounceCounterBasedClass_10_1_10
          DemRbEventClass: DemRbEventRecoverableInSameOperationCycle=true, DemRbEventStatusBitStorageTestFailed=false, DemRbEventCategoryRef=DemRbEventCategory_External
        FAULT_EPBErrorStatus_INVALID: DemCallbackEventStatusChangedRBRef=DemCallbackEventStatusChanged_Prj, DemDTCRef=DTC_INVALID_DATA_EPB, DemEnableConditionGroupRef=ECG_PublicCAN
          DemDebounceAlgorithmClass
            DemDebounceCounterBased: DemDebounceCounterBasedClassRef=DemDebounceCounterBasedClass_10_1_10
          DemRbEventClass: DemRbEventRecoverableInSameOperationCycle=true, DemRbEventStatusBitStorageTestFailed=false, DemRbEventCategoryRef=DemRbEventCategory_External
        FAULT_EPS_3_AgFailr_INVALID: DemCallbackEventStatusChangedRBRef=DemCallbackEventStatusChanged_Prj, DemDTCRef=DTC_INVALID_DATA_EPS, DemEnableConditionGroupRef=ECG_PublicCAN
          DemDebounceAlgorithmClass
            DemDebounceCounterBased: DemDebounceCounterBasedClassRef=DemDebounceCounterBasedClass_10_1_10
          DemRbEventClass: DemRbEventRecoverableInSameOperationCycle=true, DemRbEventStatusBitStorageTestFailed=false, DemRbEventCategoryRef=DemRbEventCategory_External
        FAULT_EPS_3_StrngAgSpdValidData_INVALID: DemCallbackEventStatusChangedRBRef=DemCallbackEventStatusChanged_Prj, DemDTCRef=DTC_INVALID_DATA_EPS, DemEnableConditionGroupRef=ECG_PublicCAN
          DemDebounceAlgorithmClass
            DemDebounceCounterBased: DemDebounceCounterBasedClassRef=DemDebounceCounterBasedClass_10_1_10
          DemRbEventClass: DemRbEventRecoverableInSameOperationCycle=true, DemRbEventStatusBitStorageTestFailed=false, DemRbEventCategoryRef=DemRbEventCategory_External
        FAULT_EPS_3_StrngWhlAg_INVALID: DemCallbackEventStatusChangedRBRef=DemCallbackEventStatusChanged_Prj, DemDTCRef=DTC_INVALID_DATA_EPS, DemEnableConditionGroupRef=ECG_PublicCAN
          DemDebounceAlgorithmClass
            DemDebounceCounterBased: DemDebounceCounterBasedClassRef=DemDebounceCounterBasedClass_10_1_10
          DemRbEventClass: DemRbEventRecoverableInSameOperationCycle=true, DemRbEventStatusBitStorageTestFailed=false, DemRbEventCategoryRef=DemRbEventCategory_External
        FAULT_EPS_3_StrngWhlAgValid_INVALID: DemCallbackEventStatusChangedRBRef=DemCallbackEventStatusChanged_Prj, DemDTCRef=DTC_INVALID_DATA_EPS, DemEnableConditionGroupRef=ECG_PublicCAN
          DemDebounceAlgorithmClass
            DemDebounceCounterBased: DemDebounceCounterBasedClassRef=DemDebounceCounterBasedClass_10_1_10
          DemRbEventClass: DemRbEventRecoverableInSameOperationCycle=true, DemRbEventStatusBitStorageTestFailed=false, DemRbEventCategoryRef=DemRbEventCategory_External
        FAULT_ESP1_VehicleSpeedVSOSigValidData_INVALID: DemCallbackEventStatusChangedRBRef=DemCallbackEventStatusChanged_Prj, DemDTCRef=DTC_INVALID_DATA_ESP, DemEnableConditionGroupRef=ECG_PublicCAN
          DemDebounceAlgorithmClass
            DemDebounceCounterBased: DemDebounceCounterBasedClassRef=DemDebounceCounterBasedClass_10_1_10
          DemRbEventClass: DemRbEventRecoverableInSameOperationCycle=true, DemRbEventStatusBitStorageTestFailed=false, DemRbEventCategoryRef=DemRbEventCategory_External
        FAULT_GBPositoionDisplayForPEPS_INVALID: DemCallbackEventStatusChangedRBRef=DemCallbackEventStatusChanged_Prj, DemDTCRef=DTC_INVALID_DATA_TCU, DemEnableConditionGroupRef=ECG_PublicCAN
          DemDebounceAlgorithmClass
            DemDebounceCounterBased: DemDebounceCounterBasedClassRef=DemDebounceCounterBasedClass_10_1_10
          DemRbEventClass: DemRbEventRecoverableInSameOperationCycle=true, DemRbEventStatusBitStorageTestFailed=false, DemRbEventCategoryRef=DemRbEventCategory_External
        FAULT_IPB_SimulatorPressureStatus_INVALID: DemCallbackEventStatusChangedRBRef=DemCallbackEventStatusChanged_Prj, DemDTCRef=DTC_INVALID_DATA_ESP, DemEnableConditionGroupRef=ECG_PublicCAN
          DemDebounceAlgorithmClass
            DemDebounceCounterBased: DemDebounceCounterBasedClassRef=DemDebounceCounterBasedClass_10_1_10
          DemRbEventClass: DemRbEventRecoverableInSameOperationCycle=true, DemRbEventStatusBitStorageTestFailed=false, DemRbEventCategoryRef=DemRbEventCategory_External
        FAULT_LateralAcceleration_INVALID: DemCallbackEventStatusChangedRBRef=DemCallbackEventStatusChanged_Prj, DemDTCRef=DTC_INVALID_DATA_YAS, DemEnableConditionGroupRef=ECG_PublicCAN
          DemDebounceAlgorithmClass
            DemDebounceCounterBased: DemDebounceCounterBasedClassRef=DemDebounceCounterBasedClass_7_1_7
          DemRbEventClass: DemRbEventRecoverableInSameOperationCycle=true, DemRbEventStatusBitStorageTestFailed=false, DemRbEventCategoryRef=DemRbEventCategory_External
        FAULT_LateralAccelerationSigValidData_INVALID: DemCallbackEventStatusChangedRBRef=DemCallbackEventStatusChanged_Prj, DemDTCRef=DTC_INVALID_DATA_YAS, DemEnableConditionGroupRef=ECG_PublicCAN
          DemDebounceAlgorithmClass
            DemDebounceCounterBased: DemDebounceCounterBasedClassRef=DemDebounceCounterBasedClass_7_1_7
          DemRbEventClass: DemRbEventRecoverableInSameOperationCycle=true, DemRbEventStatusBitStorageTestFailed=false, DemRbEventCategoryRef=DemRbEventCategory_External
        FAULT_LHFWheelDriveDirection_INVALID: DemCallbackEventStatusChangedRBRef=DemCallbackEventStatusChanged_Prj, DemDTCRef=DTC_INVALID_DATA_ESP, DemEnableConditionGroupRef=ECG_PublicCAN
          DemDebounceAlgorithmClass
            DemDebounceCounterBased: DemDebounceCounterBasedClassRef=DemDebounceCounterBasedClass_7_1_7
          DemRbEventClass: DemRbEventRecoverableInSameOperationCycle=true, DemRbEventStatusBitStorageTestFailed=false, DemRbEventCategoryRef=DemRbEventCategory_External
        FAULT_LHFWheelSpeedRawValidData_INVALID: DemCallbackEventStatusChangedRBRef=DemCallbackEventStatusChanged_Prj, DemDTCRef=DTC_INVALID_DATA_ESP, DemEnableConditionGroupRef=ECG_PublicCAN
          DemDebounceAlgorithmClass
            DemDebounceCounterBased: DemDebounceCounterBasedClassRef=DemDebounceCounterBasedClass_7_1_7
          DemRbEventClass: DemRbEventRecoverableInSameOperationCycle=true, DemRbEventStatusBitStorageTestFailed=false, DemRbEventCategoryRef=DemRbEventCategory_External
        FAULT_LHRWheelDriveDirection_INVALID: DemCallbackEventStatusChangedRBRef=DemCallbackEventStatusChanged_Prj, DemDTCRef=DTC_INVALID_DATA_ESP, DemEnableConditionGroupRef=ECG_PublicCAN
          DemDebounceAlgorithmClass
            DemDebounceCounterBased: DemDebounceCounterBasedClassRef=DemDebounceCounterBasedClass_7_1_7
          DemRbEventClass: DemRbEventRecoverableInSameOperationCycle=true, DemRbEventStatusBitStorageTestFailed=false, DemRbEventCategoryRef=DemRbEventCategory_External
        FAULT_LHRWheelSpeedRawValidData_INVALID: DemCallbackEventStatusChangedRBRef=DemCallbackEventStatusChanged_Prj, DemDTCRef=DTC_INVALID_DATA_ESP, DemEnableConditionGroupRef=ECG_PublicCAN
          DemDebounceAlgorithmClass
            DemDebounceCounterBased: DemDebounceCounterBasedClassRef=DemDebounceCounterBasedClass_7_1_7
          DemRbEventClass: DemRbEventRecoverableInSameOperationCycle=true, DemRbEventStatusBitStorageTestFailed=false, DemRbEventCategoryRef=DemRbEventCategory_External
        FAULT_LongitudinalAcceleration_INVALID: DemCallbackEventStatusChangedRBRef=DemCallbackEventStatusChanged_Prj, DemDTCRef=DTC_INVALID_DATA_YAS, DemEnableConditionGroupRef=ECG_PublicCAN
          DemDebounceAlgorithmClass
            DemDebounceCounterBased: DemDebounceCounterBasedClassRef=DemDebounceCounterBasedClass_7_1_7
          DemRbEventClass: DemRbEventRecoverableInSameOperationCycle=true, DemRbEventStatusBitStorageTestFailed=false, DemRbEventCategoryRef=DemRbEventCategory_External
        FAULT_LongitudinalAccelerationSig_INVALID: DemCallbackEventStatusChangedRBRef=DemCallbackEventStatusChanged_Prj, DemDTCRef=DTC_INVALID_DATA_YAS, DemEnableConditionGroupRef=ECG_PublicCAN
          DemDebounceAlgorithmClass
            DemDebounceCounterBased: DemDebounceCounterBasedClassRef=DemDebounceCounterBasedClass_7_1_7
          DemRbEventClass: DemRbEventRecoverableInSameOperationCycle=true, DemRbEventStatusBitStorageTestFailed=false, DemRbEventCategoryRef=DemRbEventCategory_External
        FAULT_MFS_Cruise_Control_INVALID: DemCallbackEventStatusChangedRBRef=DemCallbackEventStatusChanged_Prj, DemDTCRef=DTC_INVALID_DATA_MFS, DemEnableConditionGroupRef=ECG_PublicCAN
          DemDebounceAlgorithmClass
            DemDebounceCounterBased: DemDebounceCounterBasedClassRef=DemDebounceCounterBasedClass_10_1_10
          DemRbEventClass: DemRbEventRecoverableInSameOperationCycle=true, DemRbEventStatusBitStorageTestFailed=false, DemRbEventCategoryRef=DemRbEventCategory_External
        FAULT_MFS_RESPlus_INVALID: DemCallbackEventStatusChangedRBRef=DemCallbackEventStatusChanged_Prj, DemDTCRef=DTC_INVALID_DATA_MFS, DemEnableConditionGroupRef=ECG_PublicCAN
          DemDebounceAlgorithmClass
            DemDebounceCounterBased: DemDebounceCounterBasedClassRef=DemDebounceCounterBasedClass_10_1_10
          DemRbEventClass: DemRbEventRecoverableInSameOperationCycle=true, DemRbEventStatusBitStorageTestFailed=false, DemRbEventCategoryRef=DemRbEventCategory_External
        FAULT_MFS_SETMinus_INVALID: DemCallbackEventStatusChangedRBRef=DemCallbackEventStatusChanged_Prj, DemDTCRef=DTC_INVALID_DATA_MFS, DemEnableConditionGroupRef=ECG_PublicCAN
          DemDebounceAlgorithmClass
            DemDebounceCounterBased: DemDebounceCounterBasedClassRef=DemDebounceCounterBasedClass_10_1_10
          DemRbEventClass: DemRbEventRecoverableInSameOperationCycle=true, DemRbEventStatusBitStorageTestFailed=false, DemRbEventCategoryRef=DemRbEventCategory_External
        FAULT_MFS_Speed_limit_INVALID: DemCallbackEventStatusChangedRBRef=DemCallbackEventStatusChanged_Prj, DemDTCRef=DTC_INVALID_DATA_MFS, DemEnableConditionGroupRef=ECG_PublicCAN
          DemDebounceAlgorithmClass
            DemDebounceCounterBased: DemDebounceCounterBasedClassRef=DemDebounceCounterBasedClass_10_1_10
          DemRbEventClass: DemRbEventRecoverableInSameOperationCycle=true, DemRbEventStatusBitStorageTestFailed=false, DemRbEventCategoryRef=DemRbEventCategory_External
        FAULT_MFS_Time_Gap_Add_INVALID: DemCallbackEventStatusChangedRBRef=DemCallbackEventStatusChanged_Prj, DemDTCRef=DTC_INVALID_DATA_MFS, DemEnableConditionGroupRef=ECG_PublicCAN
          DemDebounceAlgorithmClass
            DemDebounceCounterBased: DemDebounceCounterBasedClassRef=DemDebounceCounterBasedClass_10_1_10
          DemRbEventClass: DemRbEventRecoverableInSameOperationCycle=true, DemRbEventStatusBitStorageTestFailed=false, DemRbEventCategoryRef=DemRbEventCategory_External
        FAULT_MFS_Time_Gap_Reduce_INVALID: DemCallbackEventStatusChangedRBRef=DemCallbackEventStatusChanged_Prj, DemDTCRef=DTC_INVALID_DATA_MFS, DemEnableConditionGroupRef=ECG_PublicCAN
          DemDebounceAlgorithmClass
            DemDebounceCounterBased: DemDebounceCounterBasedClassRef=DemDebounceCounterBasedClass_10_1_10
          DemRbEventClass: DemRbEventRecoverableInSameOperationCycle=true, DemRbEventStatusBitStorageTestFailed=false, DemRbEventCategoryRef=DemRbEventCategory_External
        FAULT_QDashACCFail_INVALID: DemCallbackEventStatusChangedRBRef=DemCallbackEventStatusChanged_Prj, DemDTCRef=DTC_INVALID_DATA_ICM, DemEnableConditionGroupRef=ECG_PublicCAN
          DemDebounceAlgorithmClass
            DemDebounceCounterBased: DemDebounceCounterBasedClassRef=DemDebounceCounterBasedClass_10_1_10
          DemRbEventClass: DemRbEventRecoverableInSameOperationCycle=true, DemRbEventStatusBitStorageTestFailed=false, DemRbEventCategoryRef=DemRbEventCategory_External
        FAULT_RHFWheelDriveDirection_INVALID: DemCallbackEventStatusChangedRBRef=DemCallbackEventStatusChanged_Prj, DemDTCRef=DTC_INVALID_DATA_ESP, DemEnableConditionGroupRef=ECG_PublicCAN
          DemDebounceAlgorithmClass
            DemDebounceCounterBased: DemDebounceCounterBasedClassRef=DemDebounceCounterBasedClass_7_1_7
          DemRbEventClass: DemRbEventRecoverableInSameOperationCycle=true, DemRbEventStatusBitStorageTestFailed=false, DemRbEventCategoryRef=DemRbEventCategory_External
        FAULT_RHFWheelSpeedRawValidData_INVALID: DemCallbackEventStatusChangedRBRef=DemCallbackEventStatusChanged_Prj, DemDTCRef=DTC_INVALID_DATA_ESP, DemEnableConditionGroupRef=ECG_PublicCAN
          DemDebounceAlgorithmClass
            DemDebounceCounterBased: DemDebounceCounterBasedClassRef=DemDebounceCounterBasedClass_7_1_7
          DemRbEventClass: DemRbEventRecoverableInSameOperationCycle=true, DemRbEventStatusBitStorageTestFailed=false, DemRbEventCategoryRef=DemRbEventCategory_External
        FAULT_RHRWheelDriveDirection_INVALID: DemCallbackEventStatusChangedRBRef=DemCallbackEventStatusChanged_Prj, DemDTCRef=DTC_INVALID_DATA_ESP, DemEnableConditionGroupRef=ECG_PublicCAN
          DemDebounceAlgorithmClass
            DemDebounceCounterBased: DemDebounceCounterBasedClassRef=DemDebounceCounterBasedClass_7_1_7
          DemRbEventClass: DemRbEventRecoverableInSameOperationCycle=true, DemRbEventStatusBitStorageTestFailed=false, DemRbEventCategoryRef=DemRbEventCategory_External
        FAULT_RHRWheelSpeedRawValidData_INVALID: DemCallbackEventStatusChangedRBRef=DemCallbackEventStatusChanged_Prj, DemDTCRef=DTC_INVALID_DATA_ESP, DemEnableConditionGroupRef=ECG_PublicCAN
          DemDebounceAlgorithmClass
            DemDebounceCounterBased: DemDebounceCounterBasedClassRef=DemDebounceCounterBasedClass_7_1_7
          DemRbEventClass: DemRbEventRecoverableInSameOperationCycle=true, DemRbEventStatusBitStorageTestFailed=false, DemRbEventCategoryRef=DemRbEventCategory_External
        FAULT_STAT_LimpHomeMode: DemCallbackEventStatusChangedRBRef=DemCallbackEventStatusChanged_Prj, DemDTCRef=DTC_INVALID_DATA_TCU, DemEnableConditionGroupRef=ECG_PublicCAN
          DemDebounceAlgorithmClass
            DemDebounceCounterBased: DemDebounceCounterBasedClassRef=DemDebounceCounterBasedClass_10_1_10
          DemRbEventClass: DemRbEventRecoverableInSameOperationCycle=true, DemRbEventStatusBitStorageTestFailed=false, DemRbEventCategoryRef=DemRbEventCategory_External
        FAULT_TargetGear_INVALID: DemCallbackEventStatusChangedRBRef=DemCallbackEventStatusChanged_Prj, DemDTCRef=DTC_INVALID_DATA_TCU, DemEnableConditionGroupRef=ECG_PublicCAN
          DemDebounceAlgorithmClass
            DemDebounceCounterBased: DemDebounceCounterBasedClassRef=DemDebounceCounterBasedClass_10_1_10
          DemRbEventClass: DemRbEventRecoverableInSameOperationCycle=true, DemRbEventStatusBitStorageTestFailed=false, DemRbEventCategoryRef=DemRbEventCategory_External
        FAULT_TIMEOUT_ABS_ESP_1: DemCallbackEventStatusChangedRBRef=DemCallbackEventStatusChanged_Prj, DemDTCRef=DTC_TIMEOUT_ESP, DemEnableConditionGroupRef=ECG_PublicCAN
          DemDebounceAlgorithmClass
            DemDebounceCounterBased: DemDebounceCounterBasedClassRef=DemDebounceCounterBasedClass_15_1_15
          DemRbEventClass: DemRbEventRecoverableInSameOperationCycle=true, DemRbEventStatusBitStorageTestFailed=false, DemRbEventCategoryRef=DemRbEventCategory_External
        FAULT_TIMEOUT_ABS_ESP_3: DemCallbackEventStatusChangedRBRef=DemCallbackEventStatusChanged_Prj, DemDTCRef=DTC_TIMEOUT_ESP, DemEnableConditionGroupRef=ECG_PublicCAN
          DemDebounceAlgorithmClass
            DemDebounceCounterBased: DemDebounceCounterBasedClassRef=DemDebounceCounterBasedClass_7_1_7
          DemRbEventClass: DemRbEventRecoverableInSameOperationCycle=true, DemRbEventStatusBitStorageTestFailed=false, DemRbEventCategoryRef=DemRbEventCategory_External
        FAULT_TIMEOUT_ABS_ESP_4: DemCallbackEventStatusChangedRBRef=DemCallbackEventStatusChanged_Prj, DemDTCRef=DTC_TIMEOUT_ESP, DemEnableConditionGroupRef=ECG_PublicCAN
          DemDebounceAlgorithmClass
            DemDebounceCounterBased: DemDebounceCounterBasedClassRef=DemDebounceCounterBasedClass_7_1_7
          DemRbEventClass: DemRbEventRecoverableInSameOperationCycle=true, DemRbEventStatusBitStorageTestFailed=false, DemRbEventCategoryRef=DemRbEventCategory_External
        FAULT_TIMEOUT_ABS_ESP_7: DemCallbackEventStatusChangedRBRef=DemCallbackEventStatusChanged_Prj, DemDTCRef=DTC_TIMEOUT_ESP, DemEnableConditionGroupRef=ECG_PublicCAN
          DemDebounceAlgorithmClass
            DemDebounceCounterBased: DemDebounceCounterBasedClassRef=DemDebounceCounterBasedClass_7_1_7
          DemRbEventClass: DemRbEventRecoverableInSameOperationCycle=true, DemRbEventStatusBitStorageTestFailed=false, DemRbEventCategoryRef=DemRbEventCategory_External
        FAULT_TIMEOUT_ABS_ESP_8: DemCallbackEventStatusChangedRBRef=DemCallbackEventStatusChanged_Prj, DemDTCRef=DTC_TIMEOUT_ESP, DemEnableConditionGroupRef=ECG_PublicCAN
          DemDebounceAlgorithmClass
            DemDebounceCounterBased: DemDebounceCounterBasedClassRef=DemDebounceCounterBasedClass_7_1_7
          DemRbEventClass: DemRbEventRecoverableInSameOperationCycle=true, DemRbEventStatusBitStorageTestFailed=false, DemRbEventCategoryRef=DemRbEventCategory_External
        FAULT_TIMEOUT_ABS_ESP_G: DemCallbackEventStatusChangedRBRef=DemCallbackEventStatusChanged_Prj, DemDTCRef=DTC_TIMEOUT_ESP, DemEnableConditionGroupRef=ECG_PublicCAN
          DemDebounceAlgorithmClass
            DemDebounceCounterBased: DemDebounceCounterBasedClassRef=DemDebounceCounterBasedClass_20_1_20
          DemRbEventClass: DemRbEventRecoverableInSameOperationCycle=true, DemRbEventStatusBitStorageTestFailed=false, DemRbEventCategoryRef=DemRbEventCategory_External
        FAULT_TIMEOUT_BCM_1: DemCallbackEventStatusChangedRBRef=DemCallbackEventStatusChanged_Prj, DemDTCRef=DTC_TIMEOUT_BCM, DemEnableConditionGroupRef=ECG_PublicCAN
          DemDebounceAlgorithmClass
            DemDebounceCounterBased: DemDebounceCounterBasedClassRef=DemDebounceCounterBasedClass_25_1_25
          DemRbEventClass: DemRbEventRecoverableInSameOperationCycle=true, DemRbEventStatusBitStorageTestFailed=false, DemRbEventCategoryRef=DemRbEventCategory_External
        FAULT_TIMEOUT_CLM_2: DemCallbackEventStatusChangedRBRef=DemCallbackEventStatusChanged_Prj, DemDTCRef=DTC_TIMEOUT_CLM, DemEnableConditionGroupRef=ECG_PublicCAN
          DemDebounceAlgorithmClass
            DemDebounceCounterBased: DemDebounceCounterBasedClassRef=DemDebounceCounterBasedClass_20_1_20
          DemRbEventClass: DemRbEventRecoverableInSameOperationCycle=true, DemRbEventStatusBitStorageTestFailed=false, DemRbEventCategoryRef=DemRbEventCategory_External
        FAULT_TIMEOUT_EMS_1: DemCallbackEventStatusChangedRBRef=DemCallbackEventStatusChanged_Prj, DemDTCRef=DTC_TIMEOUT_EMS, DemEnableConditionGroupRef=ECG_PublicCAN
          DemDebounceAlgorithmClass
            DemDebounceCounterBased: DemDebounceCounterBasedClassRef=DemDebounceCounterBasedClass_15_1_15
          DemRbEventClass: DemRbEventRecoverableInSameOperationCycle=true, DemRbEventStatusBitStorageTestFailed=false, DemRbEventCategoryRef=DemRbEventCategory_External
        FAULT_TIMEOUT_EMS_2: DemCallbackEventStatusChangedRBRef=DemCallbackEventStatusChanged_Prj, DemDTCRef=DTC_TIMEOUT_EMS, DemEnableConditionGroupRef=ECG_PublicCAN
          DemDebounceAlgorithmClass
            DemDebounceCounterBased: DemDebounceCounterBasedClassRef=DemDebounceCounterBasedClass_15_1_15
          DemRbEventClass: DemRbEventRecoverableInSameOperationCycle=true, DemRbEventStatusBitStorageTestFailed=false, DemRbEventCategoryRef=DemRbEventCategory_External
        FAULT_TIMEOUT_EMS_2_G: DemCallbackEventStatusChangedRBRef=DemCallbackEventStatusChanged_Prj, DemDTCRef=DTC_TIMEOUT_EMS, DemEnableConditionGroupRef=ECG_PublicCAN
          DemDebounceAlgorithmClass
            DemDebounceCounterBased: DemDebounceCounterBasedClassRef=DemDebounceCounterBasedClass_20_1_20
          DemRbEventClass: DemRbEventRecoverableInSameOperationCycle=true, DemRbEventStatusBitStorageTestFailed=false, DemRbEventCategoryRef=DemRbEventCategory_External
        FAULT_TIMEOUT_EMS_3: DemCallbackEventStatusChangedRBRef=DemCallbackEventStatusChanged_Prj, DemDTCRef=DTC_TIMEOUT_EMS, DemEnableConditionGroupRef=ECG_PublicCAN
          DemDebounceAlgorithmClass
            DemDebounceCounterBased: DemDebounceCounterBasedClassRef=DemDebounceCounterBasedClass_50_1_50
          DemRbEventClass: DemRbEventRecoverableInSameOperationCycle=true, DemRbEventStatusBitStorageTestFailed=false, DemRbEventCategoryRef=DemRbEventCategory_External
        FAULT_TIMEOUT_EMS_6: DemCallbackEventStatusChangedRBRef=DemCallbackEventStatusChanged_Prj, DemDTCRef=DTC_TIMEOUT_EMS, DemEnableConditionGroupRef=ECG_PublicCAN
          DemDebounceAlgorithmClass
            DemDebounceCounterBased: DemDebounceCounterBasedClassRef=DemDebounceCounterBasedClass_15_1_15
          DemRbEventClass: DemRbEventRecoverableInSameOperationCycle=true, DemRbEventStatusBitStorageTestFailed=false, DemRbEventCategoryRef=DemRbEventCategory_External
        FAULT_TIMEOUT_EPB_G: DemCallbackEventStatusChangedRBRef=DemCallbackEventStatusChanged_Prj, DemDTCRef=DTC_TIMEOUT_EPB, DemEnableConditionGroupRef=ECG_PublicCAN
          DemDebounceAlgorithmClass
            DemDebounceCounterBased: DemDebounceCounterBasedClassRef=DemDebounceCounterBasedClass_20_1_20
          DemRbEventClass: DemRbEventRecoverableInSameOperationCycle=true, DemRbEventStatusBitStorageTestFailed=false, DemRbEventCategoryRef=DemRbEventCategory_External
        FAULT_TIMEOUT_EPS_3: DemCallbackEventStatusChangedRBRef=DemCallbackEventStatusChanged_Prj, DemDTCRef=DTC_TIMEOUT_EPS, DemEnableConditionGroupRef=ECG_PublicCAN
          DemDebounceAlgorithmClass
            DemDebounceCounterBased: DemDebounceCounterBasedClassRef=DemDebounceCounterBasedClass_15_1_15
          DemRbEventClass: DemRbEventRecoverableInSameOperationCycle=true, DemRbEventStatusBitStorageTestFailed=false, DemRbEventCategoryRef=DemRbEventCategory_External
        FAULT_TIMEOUT_ICM_1: DemCallbackEventStatusChangedRBRef=DemCallbackEventStatusChanged_Prj, DemDTCRef=DTC_TIMEOUT_ICM, DemEnableConditionGroupRef=ECG_PublicCAN
          DemDebounceAlgorithmClass
            DemDebounceCounterBased: DemDebounceCounterBasedClassRef=DemDebounceCounterBasedClass_25_1_25
          DemRbEventClass: DemRbEventRecoverableInSameOperationCycle=true, DemRbEventStatusBitStorageTestFailed=false, DemRbEventCategoryRef=DemRbEventCategory_External
        FAULT_TIMEOUT_ICM_2: DemCallbackEventStatusChangedRBRef=DemCallbackEventStatusChanged_Prj, DemDTCRef=DTC_TIMEOUT_ICM, DemEnableConditionGroupRef=ECG_PublicCAN
          DemDebounceAlgorithmClass
            DemDebounceCounterBased: DemDebounceCounterBasedClassRef=DemDebounceCounterBasedClass_20_1_20
          DemRbEventClass: DemRbEventRecoverableInSameOperationCycle=true, DemRbEventStatusBitStorageTestFailed=false, DemRbEventCategoryRef=DemRbEventCategory_External
        FAULT_TIMEOUT_ICM_3: DemCallbackEventStatusChangedRBRef=DemCallbackEventStatusChanged_Prj, DemDTCRef=DTC_TIMEOUT_ICM, DemEnableConditionGroupRef=ECG_PublicCAN
          DemDebounceAlgorithmClass
            DemDebounceCounterBased: DemDebounceCounterBasedClassRef=DemDebounceCounterBasedClass_8_1_8
          DemRbEventClass: DemRbEventRecoverableInSameOperationCycle=true, DemRbEventStatusBitStorageTestFailed=false, DemRbEventCategoryRef=DemRbEventCategory_External
        FAULT_TIMEOUT_ICM_5: DemCallbackEventStatusChangedRBRef=DemCallbackEventStatusChanged_Prj, DemDTCRef=DTC_TIMEOUT_ICM, DemEnableConditionGroupRef=ECG_PublicCAN
          DemDebounceAlgorithmClass
            DemDebounceCounterBased: DemDebounceCounterBasedClassRef=DemDebounceCounterBasedClass_25_1_25
          DemRbEventClass: DemRbEventRecoverableInSameOperationCycle=true, DemRbEventStatusBitStorageTestFailed=false, DemRbEventCategoryRef=DemRbEventCategory_External
        FAULT_TIMEOUT_MFS_2: DemCallbackEventStatusChangedRBRef=DemCallbackEventStatusChanged_Prj, DemDTCRef=DTC_TIMEOUT_MFS, DemEnableConditionGroupRef=ECG_PublicCAN
          DemDebounceAlgorithmClass
            DemDebounceCounterBased: DemDebounceCounterBasedClassRef=DemDebounceCounterBasedClass_20_1_20
          DemRbEventClass: DemRbEventRecoverableInSameOperationCycle=true, DemRbEventStatusBitStorageTestFailed=false, DemRbEventCategoryRef=DemRbEventCategory_External
        FAULT_TIMEOUT_TCU_2: DemCallbackEventStatusChangedRBRef=DemCallbackEventStatusChanged_Prj, DemDTCRef=DTC_TIMEOUT_TCU, DemEnableConditionGroupRef=ECG_PublicCAN
          DemDebounceAlgorithmClass
            DemDebounceCounterBased: DemDebounceCounterBasedClassRef=DemDebounceCounterBasedClass_15_1_15
          DemRbEventClass: DemRbEventRecoverableInSameOperationCycle=true, DemRbEventStatusBitStorageTestFailed=false, DemRbEventCategoryRef=DemRbEventCategory_External
        FAULT_TIMEOUT_TCU_4: DemCallbackEventStatusChangedRBRef=DemCallbackEventStatusChanged_Prj, DemDTCRef=DTC_TIMEOUT_TCU, DemEnableConditionGroupRef=ECG_PublicCAN
          DemDebounceAlgorithmClass
            DemDebounceCounterBased: DemDebounceCounterBasedClassRef=DemDebounceCounterBasedClass_50_1_50
          DemRbEventClass: DemRbEventRecoverableInSameOperationCycle=true, DemRbEventStatusBitStorageTestFailed=false, DemRbEventCategoryRef=DemRbEventCategory_External
        FAULT_TIMEOUT_TIHU_IHU_10: DemCallbackEventStatusChangedRBRef=DemCallbackEventStatusChanged_Prj, DemDTCRef=DTC_TIMEOUT_IHU, DemEnableConditionGroupRef=ECG_PublicCAN
          DemDebounceAlgorithmClass
            DemDebounceCounterBased: DemDebounceCounterBasedClassRef=DemDebounceCounterBasedClass_20_1_20
          DemRbEventClass: DemRbEventRecoverableInSameOperationCycle=true, DemRbEventStatusBitStorageTestFailed=false, DemRbEventCategoryRef=DemRbEventCategory_External
        FAULT_TIMEOUT_YAS_1: DemCallbackEventStatusChangedRBRef=DemCallbackEventStatusChanged_Prj, DemDTCRef=DTC_TIMEOUT_YAS, DemEnableConditionGroupRef=ECG_PublicCAN
          DemDebounceAlgorithmClass
            DemDebounceCounterBased: DemDebounceCounterBasedClassRef=DemDebounceCounterBasedClass_7_1_7
          DemRbEventClass: DemRbEventRecoverableInSameOperationCycle=true, DemRbEventStatusBitStorageTestFailed=false, DemRbEventCategoryRef=DemRbEventCategory_External
        FAULT_TIMEOUT_YAS_2: DemCallbackEventStatusChangedRBRef=DemCallbackEventStatusChanged_Prj, DemDTCRef=DTC_TIMEOUT_YAS, DemEnableConditionGroupRef=ECG_PublicCAN
          DemDebounceAlgorithmClass
            DemDebounceCounterBased: DemDebounceCounterBasedClassRef=DemDebounceCounterBasedClass_7_1_7
          DemRbEventClass: DemRbEventRecoverableInSameOperationCycle=true, DemRbEventStatusBitStorageTestFailed=false, DemRbEventCategoryRef=DemRbEventCategory_External
        FAULT_VehicleStandstill_INVALID: DemCallbackEventStatusChangedRBRef=DemCallbackEventStatusChanged_Prj, DemDTCRef=DTC_INVALID_DATA_ESP, DemEnableConditionGroupRef=ECG_PublicCAN
          DemDebounceAlgorithmClass
            DemDebounceCounterBased: DemDebounceCounterBasedClassRef=DemDebounceCounterBasedClass_7_1_7
          DemRbEventClass: DemRbEventRecoverableInSameOperationCycle=true, DemRbEventStatusBitStorageTestFailed=false, DemRbEventCategoryRef=DemRbEventCategory_External
        FAULT_VFC_Line_ALV: DemCallbackEventStatusChangedRBRef=DemCallbackEventStatusChanged_Prj, DemDTCRef=DTC_INVALID_DATA_FCM, DemEnableConditionGroupRef=ECG_PrivateCAN
          DemDebounceAlgorithmClass
            DemDebounceCounterBased: DemDebounceCounterBasedClassRef=DemDebounceCounterBasedClass_4_1_4
          DemRbEventClass: DemRbEventRecoverableInSameOperationCycle=true, DemRbEventStatusBitStorageTestFailed=false, DemRbEventCategoryRef=DemRbEventCategory_External
        FAULT_VFC_Line_BlockCounter_Error: DemCallbackEventStatusChangedRBRef=DemCallbackEventStatusChanged_Prj, DemDTCRef=DTC_INVALID_DATA_FCM, DemEnableConditionGroupRef=ECG_PrivateCAN
          DemDebounceAlgorithmClass
            DemDebounceTimeBase: DemDebounceTimeBaseRef=DemDebounceTimeBaseClass_260ms
          DemRbEventClass: DemRbEventRecoverableInSameOperationCycle=true, DemRbEventStatusBitStorageTestFailed=false, DemRbEventCategoryRef=DemRbEventCategory_External
        FAULT_VFC_Line_CRC: DemCallbackEventStatusChangedRBRef=DemCallbackEventStatusChanged_Prj, DemDTCRef=DTC_INVALID_DATA_FCM, DemEnableConditionGroupRef=ECG_PrivateCAN
          DemDebounceAlgorithmClass
            DemDebounceCounterBased: DemDebounceCounterBasedClassRef=DemDebounceCounterBasedClass_4_1_4
          DemRbEventClass: DemRbEventRecoverableInSameOperationCycle=true, DemRbEventStatusBitStorageTestFailed=false, DemRbEventCategoryRef=DemRbEventCategory_External
        FAULT_VFC_Object_ALV: DemCallbackEventStatusChangedRBRef=DemCallbackEventStatusChanged_Prj, DemDTCRef=DTC_INVALID_DATA_FCM, DemEnableConditionGroupRef=ECG_PrivateCAN
          DemDebounceAlgorithmClass
            DemDebounceCounterBased: DemDebounceCounterBasedClassRef=DemDebounceCounterBasedClass_4_1_4
          DemRbEventClass: DemRbEventRecoverableInSameOperationCycle=true, DemRbEventStatusBitStorageTestFailed=false, DemRbEventCategoryRef=DemRbEventCategory_External
        FAULT_VFC_Object_BlockCounter_Error: DemCallbackEventStatusChangedRBRef=DemCallbackEventStatusChanged_Prj, DemDTCRef=DTC_INVALID_DATA_FCM, DemEnableConditionGroupRef=ECG_PrivateCAN
          DemDebounceAlgorithmClass
            DemDebounceTimeBase: DemDebounceTimeBaseRef=DemDebounceTimeBaseClass_260ms
          DemRbEventClass: DemRbEventRecoverableInSameOperationCycle=true, DemRbEventStatusBitStorageTestFailed=false, DemRbEventCategoryRef=DemRbEventCategory_External
        FAULT_VFC_Object_CRC: DemCallbackEventStatusChangedRBRef=DemCallbackEventStatusChanged_Prj, DemDTCRef=DTC_INVALID_DATA_FCM, DemEnableConditionGroupRef=ECG_PrivateCAN
          DemDebounceAlgorithmClass
            DemDebounceCounterBased: DemDebounceCounterBasedClassRef=DemDebounceCounterBasedClass_4_1_4
          DemRbEventClass: DemRbEventRecoverableInSameOperationCycle=true, DemRbEventStatusBitStorageTestFailed=false, DemRbEventCategoryRef=DemRbEventCategory_External
        FAULT_VFC_SensorState_ALV: DemCallbackEventStatusChangedRBRef=DemCallbackEventStatusChanged_Prj, DemDTCRef=DTC_INVALID_DATA_FCM, DemEnableConditionGroupRef=ECG_PrivateCAN
          DemDebounceAlgorithmClass
            DemDebounceCounterBased: DemDebounceCounterBasedClassRef=DemDebounceCounterBasedClass_3_1_3
          DemRbEventClass: DemRbEventRecoverableInSameOperationCycle=true, DemRbEventStatusBitStorageTestFailed=false, DemRbEventCategoryRef=DemRbEventCategory_External
        FAULT_VFC_SensorState_CRC: DemCallbackEventStatusChangedRBRef=DemCallbackEventStatusChanged_Prj, DemDTCRef=DTC_INVALID_DATA_FCM, DemEnableConditionGroupRef=ECG_PrivateCAN
          DemDebounceAlgorithmClass
            DemDebounceCounterBased: DemDebounceCounterBasedClassRef=DemDebounceCounterBasedClass_3_1_3
          DemRbEventClass: DemRbEventRecoverableInSameOperationCycle=true, DemRbEventStatusBitStorageTestFailed=false, DemRbEventCategoryRef=DemRbEventCategory_External
        FAULT_VFC_SensorState_TIMEOUT: DemCallbackEventStatusChangedRBRef=DemCallbackEventStatusChanged_Prj, DemDTCRef=DTC_TIMEOUT_FCM, DemEnableConditionGroupRef=ECG_PrivateCAN
          DemDebounceAlgorithmClass
            DemDebounceCounterBased: DemDebounceCounterBasedClassRef=DemDebounceCounterBasedClass_3_1_3
          DemRbEventClass: DemRbEventRecoverableInSameOperationCycle=true, DemRbEventStatusBitStorageTestFailed=false, DemRbEventCategoryRef=DemRbEventCategory_External
        FAULT_VFC_SensorState_VisionFault: DemRbEventDescription=This is reference Event configuration for Testing UseCase, DemCallbackEventStatusChangedRBRef=DemCallbackEventStatusChanged_Prj, DemDTCRef=DTC_INVALID_DATA_FCM, DemEnableConditionGroupRef=ECG_PrivateCAN
          DemDebounceAlgorithmClass
            DemDebounceCounterBased: DemDebounceCounterBasedClassRef=DemDebounceCounterBasedClass_10_1_10
          DemRbEventClass: DemRbEventRecoverableInSameOperationCycle=true, DemRbEventStatusBitStorageTestFailed=false, DemRbEventCategoryRef=DemRbEventCategory_External
        FAULT_VLC_Available_INVALID: DemCallbackEventStatusChangedRBRef=DemCallbackEventStatusChanged_Prj, DemDTCRef=DTC_INVALID_DATA_ESP, DemEnableConditionGroupRef=ECG_PublicCAN
          DemDebounceAlgorithmClass
            DemDebounceCounterBased: DemDebounceCounterBasedClassRef=DemDebounceCounterBasedClass_10_1_10
          DemRbEventClass: DemRbEventRecoverableInSameOperationCycle=true, DemRbEventStatusBitStorageTestFailed=false, DemRbEventCategoryRef=DemRbEventCategory_External
        FAULT_VLCFail_INVALID: DemCallbackEventStatusChangedRBRef=DemCallbackEventStatusChanged_Prj, DemDTCRef=DTC_INVALID_DATA_ESP, DemEnableConditionGroupRef=ECG_PublicCAN
          DemDebounceAlgorithmClass
            DemDebounceCounterBased: DemDebounceCounterBasedClassRef=DemDebounceCounterBasedClass_10_1_10
          DemRbEventClass: DemRbEventRecoverableInSameOperationCycle=true, DemRbEventStatusBitStorageTestFailed=false, DemRbEventCategoryRef=DemRbEventCategory_External
        FAULT_YawRate_INVALID: DemCallbackEventStatusChangedRBRef=DemCallbackEventStatusChanged_Prj, DemDTCRef=DTC_INVALID_DATA_YAS, DemEnableConditionGroupRef=ECG_PublicCAN
          DemDebounceAlgorithmClass
            DemDebounceCounterBased: DemDebounceCounterBasedClassRef=DemDebounceCounterBasedClass_7_1_7
          DemRbEventClass: DemRbEventRecoverableInSameOperationCycle=true, DemRbEventStatusBitStorageTestFailed=false, DemRbEventCategoryRef=DemRbEventCategory_External
        FAULT_YawrateSigValidData_INVALID: DemCallbackEventStatusChangedRBRef=DemCallbackEventStatusChanged_Prj, DemDTCRef=DTC_INVALID_DATA_YAS, DemEnableConditionGroupRef=ECG_PublicCAN
          DemDebounceAlgorithmClass
            DemDebounceCounterBased: DemDebounceCounterBasedClassRef=DemDebounceCounterBasedClass_7_1_7
          DemRbEventClass: DemRbEventRecoverableInSameOperationCycle=true, DemRbEventStatusBitStorageTestFailed=false, DemRbEventCategoryRef=DemRbEventCategory_External
        FAULT_zDummy_DTC_INVALID_DATA_IHU: DemCallbackEventStatusChangedRBRef=DemCallbackEventStatusChanged_Prj, DemDTCRef=DTC_INVALID_DATA_IHU
          DemDebounceAlgorithmClass
            DemDebounceCounterBased: DemDebounceCounterBasedClassRef=DemDebounceCounterBasedClass_Step1Up1Down_RESET
          DemRbEventClass: DemRbEventRecoverableInSameOperationCycle=true, DemRbEventStatusBitStorageTestFailed=false, DemRbEventCategoryRef=DemRbEventCategory_External
